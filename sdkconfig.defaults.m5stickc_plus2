## sdkconfig.defaults.m5stickc_plus2
```kconfig
CONFIG_IDF_TARGET="esp32"
CONFIG_KERN_BOARD_M5STICKC_PLUS2=y
CONFIG_ESPTOOLPY_FLASHSIZE_4MB=y
CONFIG_ESPTOOLPY_FLASHMODE_DIO=y
CONFIG_COMPILER_OPTIMIZATION_SIZE=y
CONFIG_LV_FONT_MONTSERRAT_14=y
CONFIG_LV_FONT_MONTSERRAT_16=y
CONFIG_LV_FONT_MONTSERRAT_20=y
CONFIG_LV_USE_QRCODE=y
CONFIG_SPIRAM=n
```
